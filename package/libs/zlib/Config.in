## package/libs/zlib/Config.in
```kconfig
menu "Configuration"
	depends on PACKAGE_zlib

config ZLIB_OPTIMIZE_SPEED
	bool "Override target optimization level (force -O3)"
	help
		Force compiling at -O3 instead of the current target optimization level.
		May increase performance considerably at the expense of binary size.

endmenu
```

## target/linux/ramips/files/drivers/crypto/mtk-eip93/Kconfig
```kconfig
# SPDX-License-Identifier: GPL-2.0

config CRYPTO_DEV_EIP93
	tristate "Driver for EIP-93 crypto engine accelerator"
	select CRYPTO_SKCIPHER
	select CRYPTO_ALGAPI
	select CRYPTO_AUTHENC
	select CRYPTO_LIB_DES
	select CRYPTO_SHA1
	select CRYPTO_SHA256
	select XFRM
	depends on MIPS && SOC_MT7621 && CRYPTO_HW
	help
	  Support for the EIP-93 crypto engine found in the Mediatek MT7621 SoC.

config EIP93_AES
	bool "Register AES algorithm implementations with the Crypto API"
	default y
	select CRYPTO_AES
	select CRYPTO_BLKCIPHER
	select CRYPTO_CBC
	select CRYPTO_CTR
	select CRYPTO_ECB
	depends on CRYPTO_DEV_EIP93
	help
	  Selecting this will offload AES - ECB, CBC and CTR crypto
	  to the EIP-93 crypto engine.

config EIP93_DES
	bool "Register legacy DES / 3DES algorithm with the Crypto API"
	default y
	select CRYPTO_BLKCIPHER
	select CRYPTO_CBC
	select CRYPTO_ECB
	select CRYPTO_LIB_DES
	depends on CRYPTO_DEV_EIP93
	help
	  Selecting this will offload DES and 3DES ECB and CBC
	  crypto to the EIP-93 crypto engine.

config EIP93_AEAD
	bool "Register AEAD algorithm with the Crypto API"
	default y
	select CRYPTO_AEAD
	select CRYPTO_AUTHENC
	select CRYPTO_MD5
	select CRYPTO_SHA1
	select CRYPTO_SHA256
	depends on CRYPTO_DEV_EIP93
	help
	  Selecting this will offload AEAD authenc(hmac(x), cipher(y))
	  crypto to the EIP-93 crypto engine.

config EIP93_PRNG
	bool "Register PRNG device with the Crypto API"
	default y
	depends on CRYPTO_DEV_EIP93
	help
	  Selecting this will add the ANSI X9.31 Pseudo Random Number Generator
	  of the EIP-93 crypto engine to the Crypto API
```
